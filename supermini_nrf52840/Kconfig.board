## supermini_nrf52840/Kconfig.board
```kconfig
# Copyright (c) 2024 Nordic Semiconductor ASA
# SPDX-License-Identifier: Apache-2.0

config BOARD_SUPERMINI_NRF52840
	bool "SuperMini nRF52840"
	depends on SOC_NRF52840_QIAA
```

## supermini_nrf52840/Kconfig.defconfig
```kconfig
# Copyright (c) 2024 Nordic Semiconductor ASA
# SPDX-License-Identifier: Apache-2.0

if BOARD_SUPERMINI_NRF52840

config BOARD
	default "supermini_nrf52840"

config BT_CTLR
   default BT


endif
```
